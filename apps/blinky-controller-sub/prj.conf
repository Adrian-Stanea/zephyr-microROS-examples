## Kconfig
```
# Copyright (c) 2025 Analog Devices, Inc.
# SPDX-License-Identifier: Apache-2.0

menu "Zephyr"
source "Kconfig.zephyr"
endmenu

module = APP
module-str = APP
source "subsys/logging/Kconfig.template.log_config"
```

## prj.conf
```kconfig
# =============================================================================
# APPLICATION-SPECIFIC CONFIGURATION
# =============================================================================

CONFIG_MICROROS_NODES="1"
CONFIG_MICROROS_PUBLISHERS="8"
CONFIG_MICROROS_SUBSCRIBERS="1"
# CONFIG_MICROROS_CLIENTS="1"
# CONFIG_MICROROS_SERVERS="1"
CONFIG_MICROROS_RMW_HISTORIC="4"
# CONFIG_MICROROS_XRCE_DDS_MTU="512"
# CONFIG_MICROROS_XRCE_DDS_HISTORIC="4"

# =============================================================================
# CORE SYSTEM CONFIGURATION
# =============================================================================

CONFIG_GPIO=y

# =============================================================================
# MICROROS LIBRARY
# =============================================================================
CONFIG_GPIO=y
CONFIG_MICROROS=y
CONFIG_CPP=y

CONFIG_MAIN_STACK_SIZE=25000
CONFIG_MAIN_THREAD_PRIORITY=3

CONFIG_NEWLIB_LIBC=y
CONFIG_NEWLIB_LIBC_NANO=n
CONFIG_PTHREAD_IPC=n

CONFIG_POSIX_API=y
CONFIG_POSIX_CLOCK=y

CONFIG_STDOUT_CONSOLE=y
CONFIG_LOG=y
CONFIG_SERIAL=y
CONFIG_UART_INTERRUPT_DRIVEN=y
CONFIG_UART_LINE_CTRL=y
```

## boards/max78002evkit_max78002_m4.overlay
```dts
/*
 * Copyright (c) 2025 Analog Devices, Inc.
 * SPDX-License-Identifier: Apache-2.0
 */

// Used in micro-ROS transport configuration
usart1: &uart0 {};
```

## src/main.c
```c
/*
 * Copyright (c) 2016 Intel Corporation
 *
 * SPDX-License-Identifier: Apache-2.0
 */
/*
 * Copyright (c) 2025 Analog Devices, Inc.
 *
 * SPDX-License-Identifier: Apache-2.0
 */

#include <zephyr/drivers/gpio.h>
#include <zephyr/kernel.h>

#include <stdio.h>

#include <rcl/rcl.h>
#include <rclc/executor.h>

#include <std_msgs/msg/int32.h>
#include <micro_ros_utilities/string_utilities.h>

#include <microros_transports.h>
#include <rmw_microros/rmw_microros.h>

/* ============================================================================
 * CONFIGURATION AND CONSTANTS
 * ============================================================================
 */

#define NODE_NAME "zephyr_blinky_controller"
#define NODE_NAMESPACE ""
#define TOPIC_NAME_MAX_LEN 32
#define TOPIC_NAME "led_control"
#define DOMAIN_ID 0

/* The devicetree node identifier for the "led0" alias. */
#define LED0_NODE DT_ALIAS(led0)

/* Error Checking Macros */
#define RCCHECK(fn)                                                            \
  {                                                                            \
    rcl_ret_t temp_rc = fn;                                                    \
    if ((temp_rc != RCL_RET_OK)) {                                             \
      printf("Failed status on line %d: %d. Aborting.\n", __LINE__,            \
             (int)temp_rc);                                                    \
      return 1;                                                                \
    }                                                                          \
  }
#define RCSOFTCHECK(fn)                                                        \
  {                                                                            \
    rcl_ret_t temp_rc = fn;                                                    \
    if ((temp_rc != RCL_RET_OK)) {                                             \
      printf("Failed status on line %d: %d. Continuing.\n", __LINE__,          \
             (int)temp_rc);                                                    \
    }                                                                          \
  }

#define EXECUTE_EVERY_N_MS(MS, X)                                              \
  do {                                                                         \
    static volatile int64_t init = -1;                                         \
    if (init == -1) {                                                          \
      init = uxr_millis();                                                     \
    }                                                                          \
    if (uxr_millis() - init > MS) {                                            \
      X;                                                                       \
      init = uxr_millis();                                                     \
    }                                                                          \
  } while (0)

/* ============================================================================
 * DATA STRUCTURES
 * ============================================================================
 */

enum states {
  WAITING_AGENT,
  AGENT_AVAILABLE,
  AGENT_CONNECTED,
  AGENT_DISCONNECTED
} state;

/* ============================================================================
 * GLOBAL VARIABLES
 * ============================================================================
 */

rclc_support_t support;
rcl_init_options_t init_options;
rcl_node_t node;
rclc_executor_t executor;
rcl_allocator_t allocator;

rcl_subscription_t subscriber_int32;
std_msgs__msg__Int32 msg_int32;

static const struct gpio_dt_spec led = GPIO_DT_SPEC_GET(LED0_NODE, gpios);

/* ============================================================================
 * FUNCTION PROTOTYPES
 * ============================================================================
 */
static bool gpio_initialize(void);
static bool create_entities(void);
static bool destroy_entities(void);
static void subscription_callback(const void *);

/* ============================================================================
 * MAIN APPLICATION
 * ============================================================================
 */
int main(void) {
  rmw_uros_set_custom_transport(MICRO_ROS_FRAMING_REQUIRED,
                                (void *)&default_params, zephyr_transport_open,
                                zephyr_transport_close, zephyr_transport_write,
                                zephyr_transport_read);

  // HW initialization
  if (!gpio_initialize()) {
    return -EIO;
  }

  // agent discovery state machine
  state = WAITING_AGENT;
  while (1) {
    switch (state) {
    case WAITING_AGENT:
      EXECUTE_EVERY_N_MS(500,
                         state = (RMW_RET_OK == rmw_uros_ping_agent(100, 1))
                                     ? AGENT_AVAILABLE
                                     : WAITING_AGENT;);
      break;
    case AGENT_AVAILABLE:
      state = (true == create_entities()) ? AGENT_CONNECTED : WAITING_AGENT;
      if (state == WAITING_AGENT) {
        destroy_entities();
      }
      break;
    case AGENT_CONNECTED:
      // main execution loop - blocking call
      rclc_executor_spin(&executor);
      state = AGENT_DISCONNECTED;
      break;
    case AGENT_DISCONNECTED:
      destroy_entities();
      state = WAITING_AGENT;
      break;
    default:
      break;
    }
  }

  return 0;
} // main

/* ============================================================================
 * FUNCTION IMPLEMENTATIONS
 * ============================================================================
 */

static bool gpio_initialize(void) {
  int ret;

  if (!gpio_is_ready_dt(&led)) {
    return false;
  }

  ret = gpio_pin_configure_dt(&led, GPIO_OUTPUT_INACTIVE);
  if (ret < 0) {
    return false;
  }
  return true;
}

static bool create_entities(void) {
  allocator = rcl_get_default_allocator();

  // create init options
  init_options = rcl_get_zero_initialized_init_options();
  RCCHECK(rcl_init_options_init(&init_options, allocator));
  RCCHECK(rcl_init_options_set_domain_id(&init_options, DOMAIN_ID))
  RCCHECK(rclc_support_init_with_options(&support, 0, NULL, &init_options,
                                         &allocator));

  // create node
  RCCHECK(rclc_node_init_default(&node, NODE_NAME, NODE_NAMESPACE, &support));

  // create subscriber
  RCCHECK(rclc_subscription_init_default(
      &subscriber_int32, &node,
      ROSIDL_GET_MSG_TYPE_SUPPORT(std_msgs, msg, Int32), TOPIC_NAME));

  // create executor
  executor = rclc_executor_get_zero_initialized_executor();
  RCCHECK(rclc_executor_init(&executor, &support.context, 1, &allocator));
  RCCHECK(rclc_executor_add_subscription(&executor, &subscriber_int32,
                                         &msg_int32, &subscription_callback,
                                         ON_NEW_DATA));

  return true;
}

static bool destroy_entities(void) {
  rmw_context_t *rmw_context = rcl_context_get_rmw_context(&support.context);
  (void)rmw_uros_set_context_entity_destroy_session_timeout(rmw_context, 0);

  RCSOFTCHECK(rcl_subscription_fini(&subscriber_int32, &node));
  RCSOFTCHECK(rclc_executor_fini(&executor));
  RCSOFTCHECK(rcl_node_fini(&node));
  RCSOFTCHECK(rclc_support_fini(&support));
  RCSOFTCHECK(rcl_node_options_fini(&init_options));
}

static void subscription_callback(const void *msgin) {
  const std_msgs__msg__Int32 *msg = (const std_msgs__msg__Int32 *)msgin;
  if (msg->data > 0) {
    gpio_pin_set_dt(&led, 1);
  } else {
    gpio_pin_set_dt(&led, 0);
  }
}
```
