## app/build/Kconfig/arch/Kconfig
```kconfig
# Load Zephyr Arch Kconfig descriptions.
osource "/home/bjh/zephyrproject/zephyr/arch/x86/Kconfig"
osource "/home/bjh/zephyrproject/zephyr/arch/xtensa/Kconfig"
osource "/home/bjh/zephyrproject/zephyr/arch/sparc/Kconfig"
osource "/home/bjh/zephyrproject/zephyr/arch/riscv/Kconfig"
osource "/home/bjh/zephyrproject/zephyr/arch/posix/Kconfig"
osource "/home/bjh/zephyrproject/zephyr/arch/nios2/Kconfig"
osource "/home/bjh/zephyrproject/zephyr/arch/mips/Kconfig"
osource "/home/bjh/zephyrproject/zephyr/arch/arm64/Kconfig"
osource "/home/bjh/zephyrproject/zephyr/arch/arm/Kconfig"
osource "/home/bjh/zephyrproject/zephyr/arch/arc/Kconfig"
```

## app/build/Kconfig/boards/Kconfig
```kconfig
# Load Zephyr board Kconfig descriptions.
osource "/home/bjh/zephyrproject/zephyr/boards/adi/apard32690/Kconfig"
```

## app/build/Kconfig/boards/Kconfig.defconfig
```kconfig
# Load Zephyr board defconfig descriptions.
osource "/home/bjh/zephyrproject/zephyr/boards/adi/apard32690/Kconfig.defconfig"
```

## app/build/Kconfig/boards/Kconfig.sysbuild
```kconfig
# Load Sysbuild board Kconfig descriptions.
osource "/home/bjh/zephyrproject/zephyr/boards/adi/apard32690/Kconfig.sysbuild"
```

## drivers/sensor/Kconfig
```kconfig
# Copyright (c) 2021 Nordic Semiconductor ASA
# SPDX-License-Identifier: Apache-2.0

if SENSOR
rsource "max31723/Kconfig"
endif # SENSOR
```

## drivers/sensor/max31723/Kconfig
```kconfig
# Copyright (c) 2021 Nordic Semiconductor ASA
# SPDX-License-Identifier: Apache-2.0

menuconfig MAX31723
	bool "MAX31723 SPI Temperature Sensor"
	default y
	depends on DT_HAS_ADI_MAX31723_ENABLED
	select SPI
	help
	  Enable MAX31723 SPI Temperature Sensor 
```
