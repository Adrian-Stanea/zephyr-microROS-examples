## dts/bindings/sensor/adi,max31723.yaml
```yaml
# Copyright (c) 2021 Nordic Semiconductor ASA
# SPDX-License-Identifier: Apache-2.0

description: |
  MAX31723 SPI Temperature Sensor, accessed through SPI bus  

  Example definition in devicetree:

  &spi0 {

    temp0: max31723@0 {
        status = "okay";
        compatible = "adi,max31723";
        reg = <0>;
        spi-max-frequency = <1000000>; /* conservatively set to 1MHz */
    };
  }

compatible: "adi,max31723"

include: ["sensor-device.yaml", "spi-device.yaml", "base.yaml"]

properties:
  oneshot_mode:
    type: boolean
    required: true
    description: oneshot configuration for temperature measurements

  resolution:
    type: int
    required: true
    description: thermometer resolution (9 to 12 bits)
    enum:
      - 0 # 9 bits
      - 1 # 10 bits
      - 2 # 11 bits
      - 3 # 12 bits

  thermostat_mode:
    type: int
    required: true
    description: thermostat mode (comparator or interrupt)
    enum:
      - 0 # Comparator Mode
      - 1 # Interrupt Mode
```

## west.yml
```yaml
manifest:
  remotes:
    - name: adi
      url-base: https://github.com/analogdevicesinc/
    - name: micro_ros
      url-base: https://github.com/micro-ROS
    - name: upstream
      url-base: https://github.com/zephyrproject-rtos


  projects:
    - name: zephyr
      remote: upstream
      revision: v4.1.0
      import:
        # By using name-allowlist we can clone only the modules that are
        # strictly needed by the application.
        name-allowlist:
          - cmsis      # required by the ARM port
          - hal_adi    # Analog Devices HAL
    - name: libmicroros
      # remote: micro_ros
      revision: humble
      path: modules/lib/micro_ros_zephyr_module
      url: https://github.com/micro-ROS/micro_ros_zephyr_module.git
```
